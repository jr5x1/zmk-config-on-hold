## config/west.yml
```yaml
# THIS SECTION DISABLED FOR UROB'S, BELOW
# manifest:
#  remotes:
#    - name: zmkfirmware
#      url-base: https://github.com/zmkfirmware
#    # Additional modules containing boards/shields/custom code can be listed here as well
#    # See https://docs.zephyrproject.org/3.2.0/develop/west/manifest.html#projects
#  projects:
#    - name: zmk
#      remote: zmkfirmware
#      revision: main
#      import: app/west.yml
#  self:
#    path: config
#
# From urob, here: https://github.com/urob/zmk
manifest:
  remotes:
    - name: urob
      url-base: https://github.com/urob
  projects:
    - name: zmk
      remote: urob
      revision: main
      import: app/west.yml
  self:
    path: config
```
