/*
 * Copyright (c) 2020 The ZMK Contributors
 *
 * SPDX-License-Identifier: MIT
 * 
 * JM: THIS KEYMAP IS FROM REDDITOR WHO RECOMMENDED UROB'S HRMs
 * https://github.com/infused-kim/zmk-config/blob/main/config/base.keymap for more
 */

// Define layer numbers
#define BASE 0
#define SYM 1
#define NAV 2
#define NUM 3
// (more layers at infused-kim's repo)

#ifdef HAS_UROB
  #define HAS_TRI_STATE
  #define HAS_NUM_WORD
#endif

// ZMK includes
#include <behaviors.dtsi>
#include <dt-bindings/zmk/keys.h>
#include <dt-bindings/zmk/bt.h>
// #include <dt-bindings/zmk/rgb.h>
#include <dt-bindings/zmk/ext_power.h>

// Personal includes
#include "includes/custom_keycodes.dtsi"
#include "includes/settings.dtsi"
//#include "includes/settings_pd.dtsi"
// #include "includes/conditional_layers.dtsi"
#include "includes/macros.dtsi"
#include "includes/combos.dtsi"
#include "includes/behaviours_homerow_mods.dtsi"
#include "includes/behaviours_mod_morph.dtsi"
#include "includes/behaviours_other.dtsi"
// #include "includes/mouse_keys.dtsi"
// #include "includes/mouse_tp.dtsi"
// #include "includes/mouse_tp_badjeff_input_listener.dtsi"

// #ifdef HAS_MOUSE_TP
//   #define U_TOG_TP_SET &tog MOUSE_TP_SET
// #else
//   #define U_TOG_TP_SET &none
// #endif  // HAS_MOUSE_TP

#define XXX &none
#define ___ &trans

#define VOICE   &kp C_VOICE_COMMAND   // short for mac dictation key (to fit into keymap section)
#define VOL_UP  &kp C_VOL_UP          // short for mac volume up

/ {

  keymap {
    compatible = "zmk,keymap";

    Base_layer {
      display-name = "Base";
      bindings = <
// ╭────────────────────────┬────────────────────────┬────────────────────────┬────────────────────────┬────────────────────────┬────────────────────────╮    ╭────────────────────────┬────────────────────────┬────────────────────────┬───────────────────────┬────────────────────────┬────────────────────────╮
//      &mm_grescm_gui           &kp Q                    &kp W                    &hm_l MY_HYPER F         &kp P                    &kp B                         &kp J                    &kp L                    &hm_r MY_HYPER U         &kp Y                    &kp SINGLE_QUOTE         &kp GRAVE
// ├────────────────────────┼────────────────────────┼────────────────────────┼────────────────────────┼────────────────────────┼────────────────────────┤    ├────────────────────────┼────────────────────────┼────────────────────────┼───────────────────────┼────────────────────────┼────────────────────────┤
//      &mm_shift_caps_word_l    &hm_l LCTRL A            &hm_l LALT R             &hm_l LGUI S             &hm_shift_l LSHFT T      &kp G                         &kp M                    &hm_shift_r RSHFT N      &hm_r RGUI E             &hm_r RALT I             &hm_r RCTRL O            &mm_shift_caps_word_r
// ├────────────────────────┼────────────────────────┼────────────────────────┼────────────────────────┼────────────────────────┼────────────────────────┤    ├────────────────────────┼────────────────────────┼────────────────────────┼───────────────────────┼────────────────────────┼────────────────────────┤
//      &kp GRAVE                &kp Z                    &kp X                    &hm_l MY_MEH C           &kp D                    &kp V                         &kp K                    &kp H                    &mm_comma_semi_meh       &mm_dot_colon            &kp SLASH                &sys_reset
// ╰────────────────────────┴────────────────────────┴────────────────────────┴────────────────────────┼────────────────────────┼────────────────────────┤    ├────────────────────────┼────────────────────────┼────────────────────────┼───────────────────────┼────────────────────────┼────────────────────────╯
//                                                                                &mm_grescm_gui           &lt_l SYM SPACE          &lt ADJUST TAB                &mm_bspc_del_layer       &lt NAV RETURN           &lt_num_word NUM NUM
//                                                                            ╰────────────────────────┴────────────────────────┴────────────────────────╯    ╰────────────────────────┴────────────────────────┴────────────────────────╯

//       >;

//╭──────╮ ╭─────────────┬─────────────┬─────────────┬─────────────┬─────────────╮ ╭──────╮ ╭─────────────┬─────────────┬─────────────┬─────────────┬─────────────╮ ╭──────╮
             &kp Q         &kp W         &hm_l MY_HYPER M  &kp B     &kp Z                    &kp J         &kp L         &kp O         &kp U         &qexcl           
//├──────┤ ├─────────────┼─────────────┼─────────────┼─────────────┼─────────────┤ ├──────┤ ├─────────────┼─────────────┼─────────────┼─────────────┼─────────────┤ ├──────┤
             &hml LCTRL N  &hml LALT R   &hml LGUI S  &hml LSHFT T   &kp G                    &kp Y         &hmr RSHFT H  &hmr LGUI E  &hmr LALT I   &hmr LCTRL A     
//├──────┤ ├─────────────┼─────────────┼─────────────┼─────────────┼─────────────┤ ├──────┤ ├─────────────┼─────────────┼─────────────┼─────────────┼─────────────┤ ├──────┤
             &kp X         &kp L         &kp C         &kp D         &kp V                    &kp K         &kp P         &comma_morph  &dot_morph    &kp SQT          
//├──────┤ ╰─────────────┼─────────────┴─────────────┼─────────────┼─────────────┤ ├──────┤ ├─────────────┼─────────────┼─────────────┴───────────────────────────╯ ├──────┤
//                                                     &smart_shft   &lt NAV RET              SMART_NUM     &lt_spc SYM 0                                             
                                                       &lt 2 BSPC    &mo NUM                  &lt 3 ENTER   &lt 1 SPACE                 
//╰──────╯                                           ╰─────────────┴─────────────╯ ╰──────╯ ╰─────────────┴─────────────╯                                           ╰──────╯

      >;

 Sym_layer {
      display-name = "Sym";
      bindings = <
//╭──────╮ ╭─────────────┬─────────────┬─────────────┬─────────────┬─────────────╮ ╭──────╮ ╭─────────────┬─────────────┬─────────────┬─────────────┬─────────────╮ ╭──────╮
             &kp ESC       &kp HASH      &kp DLLR      &kp PRCNT     &kp AMPS                 ___           &kp C_VOL_DOWN  &kp MUTE    &kp C_VOL_UP  ___
//├──────┤ ├─────────────┼─────────────┼─────────────┼─────────────┼─────────────┤ ├──────┤ ├─────────────┼─────────────┼─────────────┼─────────────┼─────────────┤ ├──────┤
             &kp TAB       &kp AT        &kp LPAR      &kp RPAR      &kp STAR                 &kp LA(N6)    &kp PREV      &kp C_PP      &kp NEXT      ___             
//├──────┤ ├─────────────┼─────────────┼─────────────┼─────────────┼─────────────┤ ├──────┤ ├─────────────┼─────────────┼─────────────┼─────────────┼─────────────┤ ├──────┤
             &kp LG(Z)     &kp LG(X)     &kp LG(C)     &kp LG(V)     ___                      &kp LA(N7)    &kp SLASH     VOICE         &kp MINUS     ___             
//├──────┤ ╰─────────────┼─────────────┴─────────────┼─────────────┼─────────────┤ ├──────┤ ├─────────────┼─────────────┼─────────────┴───────────────────────────╯ ├──────┤
                                                       ___           ___                      ___           ___                                                       
//╰──────╯                                           ╰─────────────┴─────────────╯ ╰──────╯ ╰─────────────┴─────────────╯                                           ╰──────╯

    };

Nav_layer {
      display-name = "Nav";
      bindings = <
//╭──────╮ ╭─────────────┬─────────────┬─────────────┬─────────────┬─────────────╮ ╭──────╮ ╭─────────────┬─────────────┬─────────────┬─────────────┬─────────────╮ ╭──────╮
             &kp LG(TAB)   &kp LG(GRAVE)  ___          ___           ___                      &kp CAPSLOCK  &kp HOME      &kp UP        &kp END       ___                 
//├──────┤ ├─────────────┼─────────────┼─────────────┼─────────────┼─────────────┤ ├──────┤ ├─────────────┼─────────────┼─────────────┼─────────────┼─────────────┤ ├──────┤
             &kp LCTRL     &kp LALT      &kp LGUI      &kp LSHFT     ___                      ___           &kp LEFT      &kp DOWN      &kp RIGHT     &kp DEL             
//├──────┤ ├─────────────┼─────────────┼─────────────┼─────────────┼─────────────┤ ├──────┤ ├─────────────┼─────────────┼─────────────┼─────────────┼─────────────┤ ├──────┤
             ___           &kp LC(N1)    &kp LC(N2)    &kp LC(N3)    ___                      ___           &kp PG_DN     &kp PG_UP     ___           &key_repeat         
//├──────┤ ╰─────────────┼─────────────┴─────────────┼─────────────┼─────────────┤ ├──────┤ ├─────────────┼─────────────┼─────────────┴───────────────────────────╯ ├──────┤
                                                       ___           ___                      ___           ___                                                           
//╰──────╯                                           ╰─────────────┴─────────────╯ ╰──────╯ ╰─────────────┴─────────────╯                                           ╰──────╯

    };

Num_layer {
      display-name = "Num";
      bindings = <
//╭──────╮ ╭─────────────┬─────────────┬─────────────┬─────────────┬─────────────╮ ╭──────╮ ╭─────────────┬─────────────┬─────────────┬─────────────┬─────────────╮ ╭──────╮
             ___           ___           ___           ___           ___                     &kp KP_MULTIPLY &kp KP_N7    &kp KP_N8     &kp KP_N9     &kp KP_PLUS     
//├──────┤ ├─────────────┼─────────────┼─────────────┼─────────────┼─────────────┤ ├──────┤ ├─────────────┼─────────────┼─────────────┼─────────────┼─────────────┤ ├──────┤
             &kp LCTRL     &kp LALT      &kp LGUI      &kp LSHFT     &kp KP_DOT               &kp KP_SLASH   &kp KP_N4    &kp KP_N5     &kp KP_N6     &kp KP_MINUS    
//├──────┤ ├─────────────┼─────────────┼─────────────┼─────────────┼─────────────┤ ├──────┤ ├─────────────┼─────────────┼─────────────┼─────────────┼─────────────┤ ├──────┤
           &kp LC(LGUI(L)) &kp LC(LGUI(N1)) &kp LC(LGUI(N2)) &kp LC(LGUI(N5)) &kp LC(LGUI(I))  &kp KP_EQUAL  &kp KP_N1    &kp KP_N2     &kp KP_N3     &kp KP_N0       
//├──────┤ ╰─────────────┼─────────────┴─────────────┼─────────────┼─────────────┤ ├──────┤ ├─────────────┼─────────────┼─────────────┴───────────────────────────╯ ├──────┤
                                                       ___           ___                      ___           ___                                                       
//╰──────╯                                           ╰─────────────┴─────────────╯ ╰──────╯ ╰─────────────┴─────────────╯                                           ╰──────╯

  };

};

